## boards/shields/seahorse_v1/Kconfig.defconfig
```kconfig
if SHIELD_SEAHORSE_V1_LEFT

config ZMK_KEYBOARD_NAME
	default "Seahorse v1.0"

config ZMK_SPLIT_ROLE_CENTRAL
	default y

endif

if SHIELD_SEAHORSE_V1_LEFT || SHIELD_SEAHORSE_V1_RIGHT

config ZMK_SPLIT
	default y

endif
```

## boards/shields/seahorse_v1/Kconfig.shield
```kconfig
config SHIELD_SEAHORSE_V1_LEFT
	def_bool $(shields_list_contains,seahorse_v1_left)

config SHIELD_SEAHORSE_V1_RIGHT
	def_bool $(shields_list_contains,seahorse_v1_right)
```

## boards/shields/seahorse_v2/Kconfig.defconfig
```kconfig
# Central Side Configuration
#
# The side on which the PS/2 mouse is connected MUST be the central side.
#
# By default zmk configures the LEFT side as the central side. But most people
# want to connect their pointing devices to the RIGHT side.
#
# So, you need to define that the central side is the one to which the
# pointing device is connected to.

if SHIELD_SEAHORSE_V2_RIGHT

	config ZMK_KEYBOARD_NAME
		default "Seahorse v2.0.0"

	config ZMK_SPLIT_ROLE_CENTRAL
		default y

endif

# Options that should be enabled on both sides
if SHIELD_SEAHORSE_V2_LEFT || SHIELD_SEAHORSE_V2_RIGHT

	config ZMK_SPLIT
		default y

	if ZMK_DISPLAY

		config I2C
			default y

		config SSD1306
			default y

	endif # ZMK_DISPLAY

endif
```

## config/board/shields/cradio/Kconfig.defconfig
```kconfig
# Copyright (c) 2020 The ZMK Contributors
# SPDX-License-Identifier: MIT

if SHIELD_ROADRUNNER_LEFT

config ZMK_KEYBOARD_NAME
	default "roadrunner"

config ZMK_SPLIT_ROLE_CENTRAL
	default y

endif

if SHIELD_ROADRUNNER_LEFT || SHIELD_ROADRUNNER_RIGHT

config ZMK_SPLIT
	default y

endif
```

## config/board/shields/cradio/Kconfig.shield
```kconfig
# Copyright (c) 2020 The ZMK Contributors
# SPDX-License-Identifier: MIT

config SHIELD_ROADRUNNER_LEFT
	def_bool $(shields_list_contains,roadrunner_left)

config SHIELD_ROADRUNNER_RIGHT
	def_bool $(shields_list_contains,roadrunner_right)
```

## firmware/v2/boards/shields/seahorse_v2/Kconfig.shield
```kconfig
config SHIELD_SEAHORSE_V2_LEFT
	def_bool $(shields_list_contains,seahorse_v2_left)

config SHIELD_SEAHORSE_V2_RIGHT
	def_bool $(shields_list_contains,seahorse_v2_right)
```
