/*
 * Copyright (c) 2020 Pete Johanson
 *
 * SPDX-License-Identifier: MIT
 */

 / {
    split_inputs {
        #address-cells = <1>;
        #size-cells = <0>;

        tpoint0_split: tpoint0@0 {
            compatible = "zmk,input-split";
            reg = <0>;
        };
    };

    trackpoint_listener: trackpoint_listener {
        compatible = "zmk,input_listener";
        status = "disabled";
        device = <&tpoint0_split>; 
    };
};