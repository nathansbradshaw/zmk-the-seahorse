#include "seahorse_v2.dtsi"

&kscan0 {
        col-gpios
            = <&pro_micro 16 GPIO_ACTIVE_HIGH> // col 0
            , <&pro_micro 10 GPIO_ACTIVE_HIGH> // col 1
            , <&pro_micro 14 GPIO_ACTIVE_HIGH> // col 2
            , <&pro_micro 15 GPIO_ACTIVE_HIGH> // col 3
            , <&pro_micro 18 GPIO_ACTIVE_HIGH> // col 4
            ;
};

#include "seahorse_v2_zplit.dtsi"

// Disable the central pointing device on the peripheral
&tpoint0_split { 
    status = "disabled"; 
};

// Enable and configure the left (peripheral) pointing device
&tpoint1_split {
    status = "disabled";
    // device = <&tpoint1_split>; // Reference to the left pointing device node

// Define the left pointing device node under the appropriate bus (e.g., SPI or I2C)
