/*
 * Copyright (c) 2020 Pete Johanson
 *
 * SPDX-License-Identifier: MIT
 */

#include "seahorse_v2.dtsi"


&default_transform0 {
    col-offset = <5>;
};

&kscan0 {
    col-gpios
    = <&pro_micro 16 GPIO_ACTIVE_HIGH> // col 0
    , <&pro_micro 10 GPIO_ACTIVE_HIGH> // col 1
    , <&pro_micro 14 GPIO_ACTIVE_HIGH> // col 2
    , <&pro_micro 15 GPIO_ACTIVE_HIGH> // col 3
    , <&pro_micro 18 GPIO_ACTIVE_HIGH> // col 4
    ;
};

#include "seahorse_v2_tpoint0_ps2.dtsi"

/* Installed nice!nano bootloader 0.5.0 rejects writes at/above 0xAD000.
 * Enforce its real application limit at link time; settings stay unchanged.
 */
&code_partition {
    reg = <0x26000 0x87000>;
};
