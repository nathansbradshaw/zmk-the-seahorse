## firmware/v3/boards/shields/loce_alda/Kconfig.shield
```kconfig
config SHIELD_LOCE_ALDA_LEFT
	def_bool $(shields_list_contains,loce_alda_left)

config SHIELD_LOCE_ALDA_RIGHT
	def_bool $(shields_list_contains,loce_alda_right)
```
